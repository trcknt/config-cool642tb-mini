## config/boards/shields/Test/Kconfig.defconfig
```kconfig
if SHIELD_ROBA_R

config ZMK_KEYBOARD_NAME
    default "cool642tb-mini_R"

config ZMK_SPLIT
    default y

config ZMK_SPLIT_ROLE_CENTRAL
    default y

endif

if SHIELD_ROBA_L

config ZMK_KEYBOARD_NAME
    default "cool642tb-mini_L"

config ZMK_SPLIT
    default y

endif

# バッテリーモジュールを有効にするための設定
config ZMK_EXT_MODULES
    default y

config ZMK_EXT_MODULES_BATTERY
    default y
```

## config/west.yml
```yaml
manifest:  
  remotes:  
    - name: zmkfirmware  
      url-base: https://github.com/zmkfirmware  
    - name: na-ka-no
      url-base: https://github.com/tadanaka  
  
  projects:  
    - name: zmk  
      remote: na-ka-no  # フォークしたリポジトリを参照  
      revision: main  # カスタムブランチ名  
      import: app/west.yml  
    - name: zmk-pmw3610-driver  
      remote: na-ka-no
      revision: main  
  
  self:  
    path: config
```
